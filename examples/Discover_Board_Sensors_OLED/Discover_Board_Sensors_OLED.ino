#include <Wire.h>
#include <Adafruit_BMP280.h>
#include <Adafruit_LSM6DS3.h>
#include <PCF85063TP.h>
#include <Adafruit_Si7021.h>
#include <Adafruit_GFX.h>
#include <Adafruit_SSD1306.h>

#define I2C_SDA 21
#define I2C_SCL 22
#define BMP_I2C_ADDR 0x76
#define LSM_I2C_ADDR 0x6B
#define SSD_I2C_ADDR 0x3C
#define SCREEN_WIDTH 128
#define SCREEN_HEIGHT 64

Adafruit_BMP280 bmp280;
Adafruit_LSM6DS3 lsm6ds3;
PCD85063TP RTclock;
Adafruit_Si7021 si7021;
Adafruit_SSD1306 display(SCREEN_WIDTH, SCREEN_HEIGHT, &Wire, -1);

void setup() {
  Wire.begin(I2C_SDA, I2C_SCL);
  Serial.begin(115200);

  Serial.println("Discover Board Sensors OLED test");

  if (!bmp280.begin(BMP_I2C_ADDR, BMP280_CHIPID)) {
    Serial.println("Could not find a valid BMP280 sensor!");
    while (1);
  }
  if (!lsm6ds3.begin_I2C(LSM_I2C_ADDR, &Wire, LSM6DS3_CHIP_ID)) {
    Serial.println("Could not find a valid LSM6DS3 sensor!");
    while (1);
  }
  if (!si7021.begin()) {
    Serial.println("Could not find a valid Si7021 sensor!");
    while (1);
  }
  if(!display.begin(SSD1306_SWITCHCAPVCC, SSD_I2C_ADDR)) {
    Serial.println("Could not find a valid SSD1306 screen!");
    while (1);
  }
  RTclock.begin();

  RTclock.stopClock();
  RTclock.fillByYMD(2020,10,9);
  RTclock.fillByHMS(18,00,00);
  RTclock.fillDayOfWeek(FRI);
  RTclock.setTime();
  RTclock.startClock();
}

void loop() {
  drawlogo();
  showday();
  showtime();
  showtemperature();
  showhumidity();
  showpressure();
  showaltitude();
  showxaccel();
  showyaccel();
}


#define LOGO_HEIGHT   58
#define LOGO_WIDTH    60
static const uint8_t logo_bmp[] = {
  0x00, 0x00, 0x00, 0x00, 0x00, 0x00, 0x00, 0x00, 0x00, 0x00, 0x00, 0x00, 0x00, 0x00, 0x00, 0x00, 
  0x00, 0x00, 0x00, 0x00, 0x3c, 0x00, 0x00, 0x00, 0x00, 0x00, 0x00, 0x00, 0x3c, 0x00, 0x00, 0x00, 
  0x00, 0x00, 0x00, 0x00, 0x3f, 0x07, 0x00, 0x00, 0x00, 0x00, 0x00, 0xf0, 0x1f, 0x07, 0x00, 0x00, 
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  0x00, 0x00, 0x00, 0x00, 0x00, 0x00, 0x00, 0x00, 0x00, 0x00, 0x00, 0x00, 0x00, 0x00, 0x00, 0x00
};


void drawlogo(void) {
  display.clearDisplay();
  
  display.drawBitmap(
    10,
    (display.height() - LOGO_HEIGHT) / 2,
    logo_bmp, LOGO_WIDTH, LOGO_HEIGHT, 1);
    
  display.display();

  display.startscrollright(0x00, 0x0F);
  delay(3000);
  display.stopscroll();
}

void showday(void) {
  RTclock.getTime();
  
  display.clearDisplay();
  display.setTextSize(2);
  display.setTextColor(SSD1306_WHITE);
  
  display.setCursor(0,4);
  switch (RTclock.dayOfWeek) {
    case MON:
      display.print("Monday");
      break;
    case TUE:
      display.print("Tuesday");
      break;
    case WED:
      display.print("Wednesday");
      break;
    case THU:
      display.print("Thursday");
      break;
    case FRI:
      display.print("Friday");
      break;
    case SAT:
      display.print("Saturday");
      break;
    case SUN:
      display.print("Sunday");
      break;
  }

  display.setCursor(0,44);
  display.print(RTclock.year+2000);
  display.print("/");
  display.print(RTclock.month);
  display.print("/");
  display.print(RTclock.dayOfMonth);
  display.display();
  
  delay(3000);
}

void showtime(void) {
  display.setTextSize(2);
  display.setTextColor(SSD1306_WHITE);
  
  int RThour;
  int RTminute;
  int RTsecond;
  
  int count = 0;
  while (count < 60) {
    count++;
    
    RTclock.getTime();

    RThour = RTclock.hour;
    RTminute = RTclock.minute;
    RTsecond = RTclock.second;
  
    display.clearDisplay();
    
    display.setCursor(14,24);

    display.print(RThour);
    display.print(":");
    
    if (RTminute < 10) {
      display.print("0");
    }
    display.print(RTminute);
    display.print(":");
    
    if (RTsecond < 10) {
      display.print("0");
    }
    display.print(RTsecond);

    display.display();
    
    delay(50);
  }
}

void showtemperature(void) {
  display.setTextSize(2);
  display.setTextColor(SSD1306_WHITE);
  
  int count = 0;
  while (count < 15) {
    count++;
    
    display.clearDisplay();
    
    display.setCursor(0,4);
    display.print("Temp:");
  
    display.setCursor(40,44);
    display.print(si7021.readTemperature());
    display.print(" C");
    display.display();
    
    delay(200);
  }
}

void showhumidity(void) {
  display.setTextSize(2);
  display.setTextColor(SSD1306_WHITE);
  
  int count = 0;
  while (count < 15) {
    count++;
    
    display.clearDisplay();
    
    display.setCursor(0,4);
    display.print("Humidity:");
  
    display.setCursor(40,44);
    display.print(si7021.readHumidity());
    display.print(" %");
    display.display();
    
    delay(200);
  }
}

void showpressure(void) {
  display.setTextSize(2);
  display.setTextColor(SSD1306_WHITE);
  
  int count = 0;
  while (count < 15) {
    count++;
    
    display.clearDisplay();
    
    display.setCursor(0,4);
    display.print("Pressure:");
  
    display.setCursor(0,34);
    display.print(bmp280.readPressure());

    display.setCursor(80,50);
    display.print(" Pa");
    display.display();
    
    delay(200);
  }
}

void showaltitude(void) {
  display.setTextSize(2);
  display.setTextColor(SSD1306_WHITE);
  
  int count = 0;
  while (count < 15) {
    count++;
    
    display.clearDisplay();
    
    display.setCursor(0,4);
    display.print("Altitude:");
  
    display.setCursor(30,44);
    display.print(bmp280.readAltitude(1013.25));
    display.print(" m");
    display.display();
    
    delay(200);
  }
}

void showxaccel(void) {
  display.setTextSize(2);
  display.setTextColor(SSD1306_WHITE);

  sensors_event_t accel;
  sensors_event_t gyro;
  sensors_event_t temp;
  
  int count = 0;
  while (count < 60) {
    count++;

    lsm6ds3.getEvent(&accel, &gyro, &temp);
    
    display.clearDisplay();
    
    display.setCursor(0,4);
    display.print("X accel:");
  
    display.setCursor(40,34);
    display.print(accel.acceleration.x);
      
    display.setCursor(50,50);
    display.print(" m/s^2");
    display.display();
    
    delay(50);
  }
}

void showyaccel(void) {
  display.setTextSize(2);
  display.setTextColor(SSD1306_WHITE);

  sensors_event_t accel;
  sensors_event_t gyro;
  sensors_event_t temp;
  
  int count = 0;
  while (count < 60) {
    count++;

    lsm6ds3.getEvent(&accel, &gyro, &temp);
    
    display.clearDisplay();
    
    display.setCursor(0,4);
    display.print("Y accel:");
  
    display.setCursor(40,34);
    display.print(accel.acceleration.y);
      
    display.setCursor(50,50);
    display.print(" m/s^2");
    display.display();
    delay(50);
  }
}
